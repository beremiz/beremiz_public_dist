## yocto_recipes/conf/layer.conf
```bitbake
# We have a conf and classes directory, add to BBPATH
BBPATH .= ":${LAYERDIR}"

# We have recipes-* directories, add to BBFILES
BBFILES += "${LAYERDIR}/recipes-*/*/*.bb \
            ${LAYERDIR}/recipes-*/*/*.bbappend"

BBFILE_COLLECTIONS += "meta-beremiz"
BBFILE_PATTERN_meta-beremiz = "^${LAYERDIR}/"
BBFILE_PRIORITY_meta-beremiz = "6"

LAYERDEPENDS_meta-beremiz = "core"
LAYERSERIES_COMPAT_meta-beremiz = "honister"
```
